/*
 * display.c
 *
 *  Created on: Oct 8, 2017
 *      Author: benja_000
 */

#include "display.h"
#include "main.h"
#include "task.h"
#include "spi.h"
#include "definitions.h"

// the memory buffer for the LCD
static uint8_t buffer[DISPLAY_BUFFER_LENGTH] = {
0x00, 0x00, 0x00, 0x00, 0x00, 0x00, 0x00, 0x00, 0x00, 0x00, 0x00, 0x00, 0x00, 0x00, 0x00, 0x00,
0x00, 0x00, 0x00, 0x00, 0x00, 0x00, 0x00, 0x00, 0x00, 0x00, 0x00, 0x00, 0x00, 0x00, 0x00, 0x00,
0x00, 0x00, 0x00, 0x00, 0x00, 0x00, 0x00, 0x00, 0x00, 0x00, 0x00, 0x00, 0x00, 0x00, 0x00, 0x00,
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0x80, 0x80, 0x00, 0x80, 0x80, 0x00, 0x00, 0x00, 0x00, 0x80, 0x80, 0x80, 0x80, 0x80, 0x00, 0xFF,
#if (SSD1306_LCDHEIGHT * SSD1306_LCDWIDTH > 96*16)
0xFF, 0xFF, 0x00, 0x00, 0x00, 0x00, 0x80, 0x80, 0x80, 0x80, 0x00, 0x00, 0x80, 0x80, 0x00, 0x00,
0x80, 0xFF, 0xFF, 0x80, 0x80, 0x00, 0x80, 0x80, 0x00, 0x80, 0x80, 0x80, 0x80, 0x00, 0x80, 0x80,
0x00, 0x00, 0x00, 0x00, 0x00, 0x80, 0x80, 0x00, 0x00, 0x8C, 0x8E, 0x84, 0x00, 0x00, 0x80, 0xF8,
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0x03, 0x01, 0x00, 0x00, 0x00, 0x00, 0x00, 0x00, 0x00, 0x00, 0x00, 0x00, 0x00, 0x00, 0x00, 0x00,
#if (SSD1306_LCDHEIGHT == 64)
0x00, 0x00, 0x00, 0x80, 0xC0, 0xE0, 0xF0, 0xF9, 0xFF, 0xFF, 0xFF, 0xFF, 0xFF, 0x3F, 0x1F, 0x0F,
0x87, 0xC7, 0xF7, 0xFF, 0xFF, 0x1F, 0x1F, 0x3D, 0xFC, 0xF8, 0xF8, 0xF8, 0xF8, 0x7C, 0x7D, 0xFF,
0xFF, 0xFF, 0xFF, 0xFF, 0xFF, 0xFF, 0xFF, 0x7F, 0x3F, 0x0F, 0x07, 0x00, 0x30, 0x30, 0x00, 0x00,
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0x00, 0x00, 0x00, 0x00, 0x00, 0x00, 0x00, 0x00, 0x00, 0x00, 0x00, 0x00, 0x00, 0x00, 0x00, 0x00
#endif
#endif
};

void init_display(uint8_t ext_vcc, uint8_t reset)
{
  if(reset) {
    HAL_GPIO_WritePin(DISPLAY_RST_GPIO_Port, DISPLAY_RST_Pin, GPIO_PIN_SET);
    HAL_GPIO_WritePin(DISPLAY_CS_GPIO_Port, DISPLAY_CS_Pin, GPIO_PIN_SET);
    // VDD (3.3V) goes high at start, lets just chill for a ms
    vTaskDelay(pdMS_TO_TICKS(1));
    // bring reset low
    HAL_GPIO_WritePin(DISPLAY_RST_GPIO_Port, DISPLAY_RST_Pin, GPIO_PIN_RESET);
    // wait 10ms
    vTaskDelay(pdMS_TO_TICKS(10));
    // bring out of reset
    HAL_GPIO_WritePin(DISPLAY_RST_GPIO_Port, DISPLAY_RST_Pin, GPIO_PIN_SET);
  }

  // Init sequence
  ssd1306_command(SSD1306_DISPLAYOFF);                    // 0xAE
  ssd1306_command(SSD1306_SETDISPLAYCLOCKDIV);            // 0xD5
  ssd1306_command(0x80);                                  // the suggested ratio 0x80

  ssd1306_command(SSD1306_SETMULTIPLEX);                  // 0xA8
  ssd1306_command(SSD1306_LCDHEIGHT - 1);

  ssd1306_command(SSD1306_SETDISPLAYOFFSET);              // 0xD3
  ssd1306_command(0x0);                                   // no offset
  ssd1306_command(SSD1306_SETSTARTLINE | 0x0);            // line #0
  ssd1306_command(SSD1306_CHARGEPUMP);                    // 0x8D

  if(ext_vcc) {
    ssd1306_command(0x10);
  }
  else {
    ssd1306_command(0x14);
  }

  ssd1306_command(SSD1306_MEMORYMODE);                    // 0x20
  ssd1306_command(0x00);                                  // 0x0 act like ks0108
  ssd1306_command(SSD1306_SEGREMAP | 0x1);
  ssd1306_command(SSD1306_COMSCANDEC);

 #if defined SSD1306_128_32
  ssd1306_command(SSD1306_SETCOMPINS);                    // 0xDA
  ssd1306_command(0x02);
  ssd1306_command(SSD1306_SETCONTRAST);                   // 0x81
  ssd1306_command(0x8F);

#elif defined SSD1306_128_64
  ssd1306_command(SSD1306_SETCOMPINS);                    // 0xDA
  ssd1306_command(0x12);
  ssd1306_command(SSD1306_SETCONTRAST);                   // 0x81

  if(ext_vcc) {
    ssd1306_command(0x9F);
  }
  else {
    ssd1306_command(0xCF);
  }

#endif

  ssd1306_command(SSD1306_SETPRECHARGE);                  // 0xd9

  if (ext_vcc) {
    ssd1306_command(0x22);
  }
  else {
    ssd1306_command(0xF1);
  }

  ssd1306_command(SSD1306_SETVCOMDETECT);                 // 0xDB
  ssd1306_command(0x40);
  ssd1306_command(SSD1306_DISPLAYALLON_RESUME);           // 0xA4
  ssd1306_command(SSD1306_NORMALDISPLAY);                 // 0xA6

  ssd1306_command(SSD1306_DEACTIVATE_SCROLL);

  ssd1306_command(SSD1306_DISPLAYON);//--turn on oled panel
}

void ssd1306_command(uint8_t cmd)
{
  HAL_GPIO_WritePin(DISPLAY_CS_GPIO_Port, DISPLAY_CS_Pin, GPIO_PIN_SET);
  HAL_GPIO_WritePin(DISPLAY_DC_GPIO_Port, DISPLAY_DC_Pin, GPIO_PIN_RESET);
  HAL_GPIO_WritePin(DISPLAY_CS_GPIO_Port, DISPLAY_CS_Pin, GPIO_PIN_RESET);
  HAL_SPI_Transmit(&hspi3, &cmd, 1, 0xFFFFFF);
  HAL_GPIO_WritePin(DISPLAY_CS_GPIO_Port, DISPLAY_CS_Pin, GPIO_PIN_SET);
}


// the most basic function, set a single pixel
void draw_pixel(uint16_t x, uint16_t y, uint16_t color)
{
  // make sure coordinates are in range
  if((x <= SSD1306_LCDWIDTH) && (y <= SSD1306_LCDHEIGHT)) {
    // x is which column
    switch (color) {

    case WHITE:
      buffer[x + (y >> 3) * SSD1306_LCDWIDTH] |=  (1 << (y & 7));
      break;

    case BLACK:
      buffer[x + (y >> 3) * SSD1306_LCDWIDTH] &= ~(1 << (y & 7));
      break;

    case INVERSE:
      buffer[x + (y >> 3) * SSD1306_LCDWIDTH] ^=  (1 << (y & 7));
      break;
    }
  }
}

void draw_vline(uint16_t x, uint16_t y2, uint16_t y1, uint16_t color)
{
  int16_t y = 0;

  // make sure y2 >= y1
  if(y1 > y2) {
    y = y1;
    y1 = y2;
    y2 = y;
  }

  // make sure coordinates are in range
  if(y2 < SSD1306_LCDHEIGHT && x < SSD1306_LCDWIDTH) {
    // x is which column
    switch (color) {

    case WHITE:
      for(y = y1; y <= y2; y++) {
        buffer[x + (y >> 3) * SSD1306_LCDWIDTH] |=  (1 << (y & 7));
      }
      break;

    case BLACK:
      for(y = y1; y <= y2; y++) {
        buffer[x + (y >> 3) * SSD1306_LCDWIDTH] &= ~(1 << (y & 7));
      }
      break;

    case INVERSE:
      for(y = y1; y <= y2; y++) {
        buffer[x + (y >> 3) * SSD1306_LCDWIDTH] ^=  (1 << (y & 7));
      }
      break;
    }
  }
}

void draw_hline(uint16_t y, uint16_t x2, uint16_t x1, uint16_t color)
{
  int16_t x = 0;

  // make sure x2 >= x1
  if(x1 > x2) {
    x = x1;
    x1 = x2;
    x2 = x;
  }

  // make sure coordinates are in range
  if(x2 < SSD1306_LCDWIDTH && y < SSD1306_LCDHEIGHT) {
    // x is which column
    switch (color) {

    case WHITE:
      for(x = x1; x <= x2; x++) {
        buffer[x + (y >> 3) * SSD1306_LCDWIDTH] |=  (1 << (y & 7));
      }
      break;

    case BLACK:
      for(x = x1; x <= x2; x++) {
        buffer[x + (y >> 3) * SSD1306_LCDWIDTH] &= ~(1 << (y & 7));
      }
      break;

    case INVERSE:
      for(x = x1; x <= x2; x++) {
        buffer[x + (y >> 3) * SSD1306_LCDWIDTH] ^=  (1 << (y & 7));
      }
      break;
    }
  }
}

void clear_screen(void)
{
  uint16_t i = 0;
  for(i = 0; i < DISPLAY_BUFFER_LENGTH; i++) {
    buffer[i] = 0;
  }
}

void display(void)
{
  ssd1306_command(SSD1306_COLUMNADDR);
  ssd1306_command(0);   // Column start address (0 = reset)
  ssd1306_command(SSD1306_LCDWIDTH-1); // Column end address (127 = reset)

  ssd1306_command(SSD1306_PAGEADDR);
  ssd1306_command(0); // Page start address (0 = reset)
  ssd1306_command(7); // Page end address

  HAL_GPIO_WritePin(DISPLAY_DC_GPIO_Port, DISPLAY_DC_Pin, GPIO_PIN_SET);

  HAL_GPIO_WritePin(DISPLAY_CS_GPIO_Port, DISPLAY_CS_Pin, GPIO_PIN_RESET);
  HAL_SPI_Transmit(&hspi3, buffer, (SSD1306_LCDWIDTH * SSD1306_LCDHEIGHT / 8), 0xFFFFFF);
  HAL_GPIO_WritePin(DISPLAY_CS_GPIO_Port, DISPLAY_CS_Pin, GPIO_PIN_SET);
}
